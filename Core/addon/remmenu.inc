extern  menu root_00;
#define root &root_00
extern  menu dm_exe_00;
#define dm_exe &dm_exe_00
extern  menu edit_x_00;
#define edit_x &edit_x_00
extern  menu edit_y_00;
#define edit_y &edit_y_00
extern  menu edit_z_00;
#define edit_z &edit_z_00
extern  menu edit_time_l_00;
#define edit_time_l &edit_time_l_00
extern  menu edit_time_r_00;
#define edit_time_r &edit_time_r_00
extern  menu edit_txt_00;
#define edit_txt &edit_txt_00
extern  menu edit_type_00;
#define edit_type &edit_type_00
extern  menu mode_00;
#define mode &mode_00
extern  menu cal_00;
#define cal &cal_00
extern  menu set_system_00;
#define set_system &set_system_00
extern  menu SetupMenu_00;
#define SetupMenu &SetupMenu_00
extern  menu set_meteo_00;
#define set_meteo &set_meteo_00
extern  menu Cedit_00;
#define Cedit &Cedit_00
extern  menu edit_gun_00;
#define edit_gun &edit_gun_00
extern  menu EnterPasswrd_00;
#define EnterPasswrd &EnterPasswrd_00
extern  menu edit_utm_00;
#define edit_utm &edit_utm_00
#define USER_KEYS
enum userkey {USR_START=146,GXM_MESSAGE_ID,GXM_GUN_ID,GXM_CURSOR_POS,USR_END};
